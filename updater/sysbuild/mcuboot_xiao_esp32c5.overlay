/*
 * Devicetree overlay for the MCUboot image on xiao_esp32c5.
 *
 * Selected by updater/sysbuild/CMakeLists.txt — sysbuild only ever looks for
 * one file name per image, which cannot serve four boards with different flash.
 *
 * Same two jobs as its three counterparts: give the bootloader the same
 * partition table the application uses, and link it into boot_partition.
 *
 * The second is easy to think unnecessary, because MCUboot's own
 * boot/zephyr/app.overlay already sets `zephyr,code-partition =
 * &boot_partition`. It does not apply: setting mcuboot_DTC_OVERLAY_FILE
 * *replaces* that file, exactly as a board overlay replaces app.overlay. Omit
 * the chosen node and MCUboot inherits the board's
 * `zephyr,code-partition = &slot0_partition` and links on top of the
 * application — which builds cleanly.
 *
 * On this board it would also link at the wrong *base*: the C5 loads its
 * second-stage bootloader from 0x2000, not 0x0. See esp32c5_partitions.dtsi.
 */
#include "../esp32c5_partitions.dtsi"

/ {
	chosen {
		zephyr,code-partition = &boot_partition;
	};
};
