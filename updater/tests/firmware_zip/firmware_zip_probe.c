/* Run the production resolver against exact files generated by web tests. */
#include "firmware_zip.h"
#include <stdlib.h>
#include <string.h>

static uint8_t *data;
static uint32_t size;
void fs_file_t_init(struct fs_file_t *f) { memset(f, 0, sizeof(*f)); }
int fs_open(struct fs_file_t *f, const char *path, int flags)
{
	(void)path; (void)flags;
	f->open = 1; f->position = 0; f->data = data; f->size = size;
	return 0;
}
int fs_close(struct fs_file_t *f) { f->open = 0; return 0; }
int fs_seek(struct fs_file_t *f, off_t offset, int whence)
{
	int64_t position = (int64_t)offset + (whence == FS_SEEK_END ? f->size : 0);
	if (!f->open || position < 0 || (uint64_t)position > UINT32_MAX) return -EINVAL;
	f->position = (uint32_t)position;
	return 0;
}
off_t fs_tell(struct fs_file_t *f) { return f->open ? (off_t)f->position : -EBADF; }
ssize_t fs_read(struct fs_file_t *f, void *buffer, size_t n)
{
	if (!f->open) return -EBADF;
	if (f->position >= f->size) return 0;
	if (n > f->size - f->position) n = f->size - f->position;
	memcpy(buffer, f->data + f->position, n);
	f->position += (uint32_t)n;
	return (ssize_t)n;
}

static void json_string(const char *value)
{
	putchar('"');
	for (const unsigned char *p = (const unsigned char *)value; *p; ++p) {
		if (*p == '"' || *p == '\\') putchar('\\');
		if (*p < 0x20) printf("\\u%04x", *p);
		else putchar(*p);
	}
	putchar('"');
}

int main(int argc, char **argv)
{
	if (argc != 2) return 2;
	FILE *input = fopen(argv[1], "rb");
	if (!input) return 2;
	if (fseek(input, 0, SEEK_END) != 0) { fclose(input); return 2; }
	long end = ftell(input);
	if (end < 0 || (uint64_t)end > UINT32_MAX || fseek(input, 0, SEEK_SET) != 0) {
		fclose(input); return 2;
	}
	size = (uint32_t)end;
	data = malloc(size ? size : 1);
	if (!data) { fclose(input); return 2; }
	if (fread(data, 1, size, input) != size) { free(data); fclose(input); return 2; }
	fclose(input);
	struct firmware_bundle bundle;
	char error[128];
	int rc = firmware_zip_open(argv[1], &bundle, error, sizeof(error));
	printf("{\"ok\":%s,\"type\":%u,\"binFile\":", rc == 0 ? "true" : "false", bundle.type);
	json_string(rc == 0 ? bundle.bin.name : "");
	printf(",\"datFile\":");
	json_string(rc == 0 ? bundle.dat.name : "");
	puts("}");
	firmware_zip_close();
	free(data);
	return 0;
}
